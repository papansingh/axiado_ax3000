## arch/arm/mach-axiado/Kconfig
```kconfig
if ARCH_AXIADO

config SYS_ARCH
default "arm"

config SYS_CPU
default "armv8"

config SYS_SOC
default "ax3000"

source "board/axiado/ax3000/Kconfig"

endif
```

## board/axiado/ax3000/Kconfig
```kconfig
if ARCH_AXIADO

config SYS_BOARD
default "ax3000"

config SYS_VENDOR
default "axiado"

config SYS_CONFIG_NAME
default "axiado_ax3000"

config SYS_UBOOT_START
	hex "U-Boot entry point"
	default 0x3D080000
	help
	  This is the memory address where the CPU will jump to start
	  executing U-Boot. It is almost always the same as TEXT_BASE.
endif
```

## configs/axiado_ax3000_defconfig
```kconfig
CONFIG_ARM=y
CONFIG_ARCH_AXIADO=y
CONFIG_ARM64=y
CONFIG_LTO=y
CONFIG_SYS_TEXT_BASE=0x82000000
CONFIG_SYS_SDRAM_BASE=0x3D000000
CONFIG_TEXT_BASE=0x3D080000
CONFIG_SYS_UBOOT_START=0x82000000
CONFIG_SYS_LOAD_ADDR=0x40000000
CONFIG_NR_DRAM_BANKS=2
CONFIG_OF_CONTROL=y
CONFIG_OF_EMBED=y
CONFIG_DM=y
CONFIG_DM_SERIAL=y
CONFIG_ZYNQ_SERIAL=y
CONFIG_GICV3=y
CONFIG_SYS_MALLOC_F_LEN=0x2000
CONFIG_ENV_IS_IN_NOWHERE=y
CONFIG_SYS_LONGHELP=n
    
# A minimal set of commands for automatic booting
CONFIG_CMD_BOOTZ=y
CONFIG_CMD_MMC=y
CONFIG_MMC=y
CONFIG_DM_MMC=y
CONFIG_CMD_FAT=y
CONFIG_CMD_FS_GENERIC=y
    
CONFIG_BAUDRATE=115200
CONFIG_DEFAULT_DEVICE_TREE="axiado_ax3000"
CONFIG_SYS_PROMPT="> "
    
# Make U-Boot boot automatically without user interaction
CONFIG_USE_BOOTCOMMAND=y
CONFIG_BOOTCOMMAND="mmc dev 0; fatload mmc 0:1 ${kernel_addr_r} Image && bootz ${kernel_addr_r} - ${fdt_addr}"
CONFIG_BOOT_RETRY_TIME=-1
CONFIG_AUTO_BOOT_STOP_STR=""
```
